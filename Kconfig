## Kconfig
```kconfig
config PLATFORM
    string "choose the platform for the project"
    default "stm32f722xx"

config FREERTOS
    bool "Enable FreeRTOS"
    default n

menu "FreeRTOS Configuration"
depends on FREERTOS
    config FREERTOS_TASKS
        bool "FreeRTOS Tasks"
        default n
        
    config FREERTOS_CROUTINE
        bool "FreeRTOS Croutine"
        default n
        
    config FREERTOS_EVENT_GROUP
        bool "FreeRTOS Event Group"
        default n
        
    config FREERTOS_LIST
        bool "FreeRTOS List"
        default n
        
    config FREERTOS_QUEUE
        bool "FreeRTOS Queue"
        default n
        
    config FREERTOS_STREAM_BUFFER
        bool "FreeRTOS Stream Buffer"
        default n
        
    config FREERTOS_TIMERS
        bool "FreeRTOS Timers"
        default n
endmenu # FreeRTPS Configuration

menu "Drivers"

config UART
    bool "UART"
    default n

menu "UART Options"
depends on UART

    config SEND_TIMEOUT
    int "UART send timeout (ms)"
    default 10000

endmenu # UART Options

config MIDI
    bool "MIDI"
    default n
    depends on UART

config SPI
    bool "SPI"
    default n

config W25Q128JV
    depends on SPI
    bool "W25Q128JV"
    default n

config KEYBOARD
    depends on UART
    bool "keyboard"
    default n

menu "Keyboard Options"
depends on KEYBOARD

    config ROWS
    int "number of rows"
    default 8

    config COLUMNS
    int "number of columns"
    default 16

    config KEY_SCAN_MS
    int "key scan period (ms)"
    default 10

    config ROLLOVER
    int "max key rollover"
    default 2

endmenu # Keyboard Options

config I2C
    bool "I2C"
    default n

config SSD1306
    depends on I2C
    bool "SSD1306"
    default n

endmenu # Drivers

menu "Sequencer Options"

config TEMPO
    int "default tempo"
    default 140

config PPQN
    int "PPQN"
    default 96

config TOTAL_SEQUENCES
    int "total sequences available"
    default 64

config MAX_SEQUENCES
    int "max number of concurrent sequences"
    default 16

config PACKET_BUFFER_LENGTH
    int "length of the midi packet buffer"
    default 8

config MAX_POLYPHONY
    int "max number of polyphonic voices per sequence"
    default 4

config STEPS_PER_SEQUENCE
    int "number of steps per sequence"
    default 64

menu "Flash Memory Configuration"

config SEQ_ADDR_OFFSET
    int "the distance in pages between the start of sequences in memory"
    default 0x10000

endmenu # Flash Memory Configuration

endmenu # Sequencer Options
```
